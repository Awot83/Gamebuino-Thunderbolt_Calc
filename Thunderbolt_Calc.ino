#include <SPI.h>
#include <Gamebuino.h>

const byte logo[] PROGMEM = {64, 36, 0x0, 0x0, 0x0, 0x0, 0x0, 0x0, 0x0, 0x0, 0xFF, 0xFF, 0xFF,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 0xFF,};
const byte boom[] PROGMEM = {64, 36, 0x0, 0x0, 0x0, 0x0, 0x0, 0x0, 0x0, 0x0, 0x0, 0x0, 0x0,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 0x0,};
const byte lightining[] PROGMEM = {64, 36, 0x0, 0x0, 0x0, 0x0, 0x0, 0x0, 0x0, 0x0, 0x0, 0x0, 0x0,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 0x0,};


Gamebuino gb;

extern const byte font3x3[]; //a really tiny font
int ThunderState;
float SoundSpeed = 340.29;
float ThunderTemp = 0;
float Thunder1 = 0;
float Thunder2 = 0;   //
float Thunder3 = 0;     //
float Thunder4 = 0;   //
int x = 0;   //
int y = 0;
int i = 0;
int j = 0;
int tempThund1 = 0;   //
int tempThund2 = 0;
int tempThundTemp = 0;
float temp = 0;
int initialValue = 0;

void setup() {
  gb.begin();
  gb.titleScreen(F(""), logo);
  gb.battery.show = false;
}

void loop() {
  if (gb.update()) {



    // exit game
    if (gb.buttons.pressed(BTN_C)) {
      setup();
    }

    gb.display.drawRect(1, 6, 43, 39);
    gb.display.drawLine(44,38,LCDWIDTH ,38 );
    if (x == 0) {
      gb.display.cursorX = 3;
      gb.display.cursorY = 10;
      // gb.display.setFont(font3x3);
      gb.display.print("Press A if");
      gb.display.drawBitmap(5, 12, lightining);
      if (gb.buttons.pressed(BTN_A)) {
        x = 1;

      }
    }


    if (x == 1) {
      gb.display.cursorX = 3;
      gb.display.cursorY = 10;
      //   gb.display.setFont(font3x3);
      gb.display.print("Press B if");
      gb.display.drawBitmap(5, 7, boom);
      temp++;
      if (gb.buttons.pressed(BTN_B)) {
        x = 0;


        tempThund2 = temp;
        tempThund1 = tempThundTemp;

        switch (i) {
          case 0:
            Thunder1 = temp / 20 * SoundSpeed;
            temp = 0;
            i++;
            break;
          case 1:
            Thunder2 = temp / 20 * SoundSpeed;
            temp = 0;
            i++;
            initialValue = 1;
            break;

          case 2:
            Thunder3 = temp / 20 * SoundSpeed;
            temp = 0;
            i++;
            break;

          case 3:
            Thunder4 = temp / 20 * SoundSpeed;
            temp = 0;
            i = 0;
            break;

        }

      }
    }



    gb.display.cursorX = 2;
    gb.display.cursorY = 0;
    gb.display.print(temp / 20);
    gb.display.cursorX = 23;
    gb.display.print("Sec");


    gb.display.cursorX = 50;
    gb.display.cursorY = 0;
    gb.display.print(Thunder1);
    gb.display.cursorX = 75;
    gb.display.print("m");


    gb.display.cursorX = 50;
    gb.display.cursorY = 10;
    gb.display.print(Thunder2);
    gb.display.cursorX = 75;
    gb.display.print("m");

    gb.display.cursorX = 50;
    gb.display.cursorY = 20;
    gb.display.print(Thunder3);
    gb.display.cursorX = 75;
    gb.display.print("m");

    gb.display.cursorX = 50;
    gb.display.cursorY = 30;
    gb.display.print(Thunder4);
    gb.display.cursorX = 75;
    gb.display.print("m");
    
 
    ThunderState = tempThund2 - tempThund1;
    tempThundTemp = tempThund2;
    
    gb.display.cursorX = 45;
    gb.display.cursorY = 40;
    //gb.display.setFont(font3x3);
    if (ThunderState > 0) {
      if (initialValue != 0) {
        gb.display.print("Receding>");
      }
    }
    if (ThunderState < 0) {
      if (initialValue != 0) {
        gb.display.print("Approach<");
      }
    }
        if (ThunderState = 0) {
      if (initialValue != 0) {
        gb.display.print("Same =");
      }
    }
  }

}
